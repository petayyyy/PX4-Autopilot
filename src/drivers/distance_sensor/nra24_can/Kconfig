## src/drivers/distance_sensor/nra24_can/Kconfig
```kconfig
menuconfig DRIVERS_DISTANCE_SENSOR_NRA24_CAN
    bool "nra24_can"
    depends on DRIVERS_UAVCAN
    default n
    ---help---
        Nanoradar NRA24 native classic CAN rangefinder for single-port STM32H7 boards.
```

## src/drivers/dshot_4way/Kconfig
```kconfig
menuconfig DRIVERS_DSHOT_4WAY
	bool "dshot_4way (BLHeli 4way passthrough)"
	default n
	---help---
		BLHeli/SiLabs bootloader 4way passthrough over a serial port,
		so esc-configurator / BLHeliSuite can read & write ESC settings
		(e.g. Beacon Delay) with the ESCs soldered to the flight controller.
```

## src/modules/log_download_bridge/Kconfig
```kconfig
menuconfig MODULES_LOG_DOWNLOAD_BRIDGE
	bool "log_download_bridge"
	default n
	---help---
		Download the latest .ulg from SD over uXRCE-DDS (reliable pull by offset).
```

## src/modules/param_dds_bridge/Kconfig
```kconfig
menuconfig MODULES_PARAM_DDS_BRIDGE
	bool "param_dds_bridge"
	default n
	---help---
		Set/get PX4 parameters by name over uXRCE-DDS (param_bridge_request/response).
```
